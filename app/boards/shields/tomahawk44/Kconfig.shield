## app/boards/shields/tomahawk44/Kconfig.shield
```kconfig
# Copyright (c) 2020 Pete Johanson
# SPDX-License-Identifier: MIT

config SHIELD_TOMAHAWK44_LEFT
    def_bool $(shields_list_contains,tomahawk44_left)

config SHIELD_TOMAHAWK44_RIGHT
    def_bool $(shields_list_contains,tomahawk44_right)
```
