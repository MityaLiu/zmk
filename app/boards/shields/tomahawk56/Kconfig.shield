## app/boards/shields/tomahawk56/Kconfig.shield
```kconfig
# Copyright (c) 2020 Pete Johanson
# SPDX-License-Identifier: MIT

config SHIELD_TOMAHAWK56_LEFT
    def_bool $(shields_list_contains,tomahawk56_left)

config SHIELD_TOMAHAWK56_RIGHT
    def_bool $(shields_list_contains,tomahawk56_right)
```
